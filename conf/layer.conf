## conf/layer.conf
```bitbake
# We have a conf and classes directory, add to BBPATH
BBPATH .= ":${LAYERDIR}"

# We have recipes-* directories, add to BBFILES
BBFILES += "${LAYERDIR}/recipes-*/*/*.bb \
            ${LAYERDIR}/recipes-*/*/*.bbappend"

BBFILE_COLLECTIONS += "meta-beaglebone-exp"
BBFILE_PATTERN_meta-beaglebone-exp = "^${LAYERDIR}/"
BBFILE_PRIORITY_meta-beaglebone-exp = "7"

LAYERDEPENDS_meta-beaglebone-exp = "core"
LAYERSERIES_COMPAT_meta-beaglebone-exp = "hardknott"
```
